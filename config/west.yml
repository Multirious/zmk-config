## config/west.yml
```yaml
manifest:
  remotes:
    - name: zmkfirmware
      url-base: https://github.com/zmkfirmware
    - name: munnich # # For apiaster
      url-base: https://github.com/nmunnich
    - name: zzeneg # For KeyPeek, provides Raw HID module
      url-base: https://github.com/zzeneg
    - name: srwi # For KeyPeek
      url-base: https://github.com/srwi
  projects:
    - name: zmk
      remote: zmkfirmware
      revision: acfd8e5ea76cf23ad1c9b6b99848f97a95224257  # v0.3-branch
      import: app/west.yml
    - name: zephyr
      remote: zmkfirmware
      revision: dacab4875df72109b96cc8977547a0dc04875bcd  # v3.5.0+zmk-fixes
      import:
        name-blocklist:
          - ci-tools
          - hal_altera
          - hal_cypress
          - hal_infineon
          - hal_microchip
          - hal_nxp
          - hal_openisa
          - hal_silabs
          - hal_xtensa
          - hal_st
          - hal_ti
          - loramac-node
          - mcuboot
          - mcumgr
          - net-tools
          - openthread
          - edtt
          - trusted-firmware-m
    - name: zmk-apiaster-module
      remote: munnich
      revision: 4279902af1c2130ab1a2ec23e916239b090780ff
      import: config/west.yml
    - name: zmk-raw-hid
      remote: zzeneg
      revision: e25e325adc90fccb60cc08393b8c2b0ba6d647c7
    - name: zmk-keypeek-layer-notifier
      remote: srwi
      revision: ad688638517baf527e66a20596aa152cb42a1cd4
  self:
    path: config
```
